## Kconfig
```kconfig
#Process Integrity Evaluator
#Authored By Bill Zeng

config PIE
bool "Process Integrity Evaluator"
default y
help
This is an integrity evaluator assigned as a coursework for the undergraduate's final.
```

## security/integrity/pie/Kconfig
```kconfig
#
# 39211306 - Bill Homework
#

config PIE
	bool "Process Integrity Evaluator"
	depends on ACPI
	select SECURITYFS
	select CRYPTO_SHA1
	select TCG_TPM
	select TCG_TIS
	help
	  Process Integrity Evaluator -> homework : (

config PIE_MEASURE_PCR_IDX
	int
	depends on IMA
	range 8 14
	default 10
	help
	  PIE PCR Index -> Choose it yourself

config PIE_LSM_RULES
	bool
	depends on PIE && AUDIT && (SECURITY_SELINUX || SECURITY_SMACK)
	default y
	help
	  PIE LSM Rules
 
config PIE_AUDIT
	bool
	depends on PIE
	default y
	help
	  Output PIE verification information at start.
```
